## config/boards/shields/SplitLemon/Kconfig.defconfig
```kconfig
if SHIELD_SPLITLEMON_LEFT

config ZMK_KEYBOARD_NAME
    default "SplitLemon"

config ZMK_SPLIT_ROLE_CENTRAL
    default y


endif

if SHIELD_SPLITLEMON_LEFT || SHIELD_SPLITLEMON_RIGHT

config ZMK_SPLIT
    default y


endif
```

## config/boards/shields/SplitLemon/Kconfig.shield
```kconfig
config SHIELD_SPLITLEMON
    def_bool $(shields_list_contains,SplitLemon_left)

config SHIELD_SPLITLEMON
    def_bool $(shields_list_contains,SplitLemon_right)
```
