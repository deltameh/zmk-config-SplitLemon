

#include "SplitLemon.dtsi"

&default_transform {
    col-offset = <6>;
};

&five_column_transform {
    col-offset = <6>;
};

    kscan0: kscan {
        compatible = "zmk,kscan-gpio-matrix";

        diode-direction = "col2row";
        col-gpios
        = <&gpio1 15 GPIO_ACTIVE_HIGH>,
          <&gpio0 2 GPIO_ACTIVE_HIGH>,
          <&gpio0 29 GPIO_ACTIVE_HIGH>,
          <&gpio0 31 GPIO_ACTIVE_HIGH>,
          <&gpio1 4 GPIO_ACTIVE_HIGH>,
          <&gpio1 6 GPIO_ACTIVE_HIGH>
        ;

        row-gpios
            = <&gpio1 13 (GPIO_ACTIVE_HIGH | GPIO_PULL_DOWN)>,
              <&gpio1 11 (GPIO_ACTIVE_HIGH | GPIO_PULL_DOWN)>,
              <&gpio0 10 (GPIO_ACTIVE_HIGH | GPIO_PULL_DOWN)>,
              <&gpio0 9 (GPIO_ACTIVE_HIGH | GPIO_PULL_DOWN)>;
    };


