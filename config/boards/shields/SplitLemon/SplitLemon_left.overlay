#include <dt-bindings/zmk/matrix_transform.h>


#include "SplitLemon.dtsi"


    kscan0: kscan {
        compatible = "zmk,kscan-gpio-matrix";
        wakeup-source;

        diode-direction = "col2row";
        col-gpios
        = <&gpio1 13 GPIO_ACTIVE_HIGH>,
          <&gpio1 11 GPIO_ACTIVE_HIGH>,
          <&gpio0 10 GPIO_ACTIVE_HIGH>,
          <&gpio0 9 GPIO_ACTIVE_HIGH>,
          <&gpio0 6 GPIO_ACTIVE_HIGH>,
          <&gpio0 8 GPIO_ACTIVE_HIGH>
        ;

        row-gpios
            = <&gpio0 31 (GPIO_ACTIVE_HIGH | GPIO_PULL_DOWN)>,
              <&gpio0 29 (GPIO_ACTIVE_HIGH | GPIO_PULL_DOWN)>,
              <&gpio0 2 (GPIO_ACTIVE_HIGH | GPIO_PULL_DOWN)>,
              <&gpio1 15 (GPIO_ACTIVE_HIGH | GPIO_PULL_DOWN)>;
    };

