/ {
    chosen {
        zmk,kscan = &default_kscan;
        zmk,matrix_transform = &default_transform;
    };


kscan0: kscan0 {
        compatible = "zmk,kscan-gpio-matrix";
        diode-direction = "col2row";
        wakeup-source;

    col-gpios
        = <&gpio1 13 GPIO_ACTIVE_HIGH>,
          <&gpio1 11 GPIO_ACTIVE_HIGH>,
          <&gpio0 10 GPIO_ACTIVE_HIGH>,
          <&gpio0 9 GPIO_ACTIVE_HIGH>,
          <&gpio0 6 GPIO_ACTIVE_HIGH>,
          <&gpio0 8 GPIO_ACTIVE_HIGH>,
          <&gpio1 15 GPIO_ACTIVE_HIGH>,
          <&gpio0 2 GPIO_ACTIVE_HIGH>,
          <&gpio0 29 GPIO_ACTIVE_HIGH>,
          <&gpio0 31 GPIO_ACTIVE_HIGH>,
          <&gpio1 4 GPIO_ACTIVE_HIGH>,
          <&gpio1 6 GPIO_ACTIVE_HIGH>
        ;
        row-gpios
            = <&gpio0 31 (GPIO_ACTIVE_HIGH | GPIO_PULL_DOWN)>,
              <&gpio0 29 (GPIO_ACTIVE_HIGH | GPIO_PULL_DOWN)>,
              <&gpio0 2 (GPIO_ACTIVE_HIGH | GPIO_PULL_DOWN)>,
              <&gpio1 15 (GPIO_ACTIVE_HIGH | GPIO_PULL_DOWN)>,
              <&gpio1 13 (GPIO_ACTIVE_HIGH | GPIO_PULL_DOWN)>,
              <&gpio1 11 (GPIO_ACTIVE_HIGH | GPIO_PULL_DOWN)>,
              <&gpio0 10 (GPIO_ACTIVE_HIGH | GPIO_PULL_DOWN)>,
              <&gpio0 9 (GPIO_ACTIVE_HIGH | GPIO_PULL_DOWN)>
            ;
  };
};